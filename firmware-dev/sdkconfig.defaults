## firmware-dev/sdkconfig.defaults
```kconfig
# Rust often needs a bit of an extra main task stack size compared to C (the default is 3K)
CONFIG_ESP_MAIN_TASK_STACK_SIZE=8000

# Use this to set FreeRTOS kernel tick frequency to 1000 Hz (100 Hz by default).
# This allows to use 1 ms granularity for thread sleeps (10 ms by default).
CONFIG_FREERTOS_HZ=1000

# Workaround for https://github.com/espressif/esp-idf/issues/7631
CONFIG_MBEDTLS_CERTIFICATE_BUNDLE=n
CONFIG_MBEDTLS_CERTIFICATE_BUNDLE_DEFAULT_FULL=n

# Disable Bluetooth for simulation mode (simulated in software instead)
CONFIG_BT_ENABLED=n
CONFIG_BT_BLE_ENABLED=n

# Disable WiFi hardware for simulation mode (simulated in software instead)
CONFIG_ESP_WIFI_ENABLED=n

# Enable logging for simulation debugging
CONFIG_LOG_DEFAULT_LEVEL_DEBUG=y
CONFIG_LOG_DEFAULT_LEVEL=4

# Optimize for simulation
CONFIG_COMPILER_OPTIMIZATION_SIZE=y
```

## sdkconfig.defaults
```kconfig
# Rust often needs a bit of an extra main task stack size compared to C (the default is 3K)
CONFIG_ESP_MAIN_TASK_STACK_SIZE=8000

# Use this to set FreeRTOS kernel tick frequency to 1000 Hz (100 Hz by default).
# This allows to use 1 ms granularity for thread sleeps (10 ms by default).
#CONFIG_FREERTOS_HZ=1000

# Workaround for https://github.com/espressif/esp-idf/issues/7631
#CONFIG_MBEDTLS_CERTIFICATE_BUNDLE=n
#CONFIG_MBEDTLS_CERTIFICATE_BUNDLE_DEFAULT_FULL=n

# Enable Bluetooth support
CONFIG_BT_ENABLED=y
CONFIG_BT_BLE_ENABLED=y
CONFIG_BT_BLUEDROID_ENABLED=y
CONFIG_BT_BLE_42_FEATURES=y

# BLE advertising configuration  
CONFIG_BT_BLE_ADV_REPORT_FLOW_CTRL_SUPP=y
CONFIG_BT_BLE_ADV_REPORT_FLOW_CTRL_NUM=100

# Increase BLE memory allocation
CONFIG_BT_BLE_DYNAMIC_ENV_MEMORY=y

# ===== MQTT DEBUGGING CONFIGURATION =====
# Enable MQTT client debugging
CONFIG_MQTT_PROTOCOL_311=y
CONFIG_MQTT_TRANSPORT_SSL=y
CONFIG_MQTT_TRANSPORT_WEBSOCKET=n
CONFIG_MQTT_TRANSPORT_WEBSOCKET_SECURE=n

# MQTT client debugging
CONFIG_MQTT_LOG_ERROR_ON=y
CONFIG_MQTT_LOG_WARN_ON=y
CONFIG_MQTT_LOG_INFO_ON=y
CONFIG_MQTT_LOG_DEBUG_ON=y

# MQTT client configuration
CONFIG_MQTT_TASK_CORE_ID=0
CONFIG_MQTT_TASK_STACK_SIZE=6144
CONFIG_MQTT_TASK_PRIORITY=5
CONFIG_MQTT_USE_CUSTOM_CONFIG=y
CONFIG_MQTT_TCP_DEFAULT_PORT=1883
CONFIG_MQTT_SSL_DEFAULT_PORT=8883
CONFIG_MQTT_WS_DEFAULT_PORT=80
CONFIG_MQTT_WSS_DEFAULT_PORT=443
CONFIG_MQTT_BUFFER_SIZE=1024
CONFIG_MQTT_TASK_STACK_SIZE_BYTES=6144

# ===== TLS/SSL DEBUGGING =====
# Enable TLS debugging
CONFIG_MBEDTLS_SSL_DEBUG_ALL=y
CONFIG_MBEDTLS_SSL_DEBUG_MSG=y
CONFIG_MBEDTLS_SSL_DEBUG_CRT=y
CONFIG_MBEDTLS_SSL_DEBUG_BUF=y
CONFIG_MBEDTLS_SSL_DEBUG_ECP=y
CONFIG_MBEDTLS_SSL_DEBUG_NET=y
CONFIG_MBEDTLS_SSL_DEBUG_MPI=y
CONFIG_MBEDTLS_SSL_DEBUG_PK=y
CONFIG_MBEDTLS_SSL_DEBUG_PKCS12=y

# TLS configuration for AWS IoT
CONFIG_MBEDTLS_SSL_PROTO_TLS1_2=y
CONFIG_MBEDTLS_SSL_CIPHERSUITES=y
CONFIG_MBEDTLS_SSL_RENEGOTIATION=y
CONFIG_MBEDTLS_SSL_MAX_FRAGMENT_LENGTH=y
CONFIG_MBEDTLS_SSL_ALPN=y
CONFIG_MBEDTLS_SSL_SESSION_TICKETS=y

# ===== TRANSPORT DEBUGGING =====
# Enable transport layer debugging
CONFIG_TRANSPORT_WS=y
CONFIG_TRANSPORT_WS_SECURE=y
CONFIG_TRANSPORT_WS_SECURE_DEFAULT_PORT=443

# ===== LOGGING CONFIGURATION =====
# Enable all logging levels
CONFIG_LOG_DEFAULT_LEVEL_DEBUG=y
CONFIG_LOG_DEFAULT_LEVEL=4
CONFIG_LOG_MAXIMUM_LEVEL=4
CONFIG_LOG_COLORS=y
CONFIG_LOG_TIMESTAMP_SOURCE_RTOS=y

# Component-specific logging
CONFIG_MQTT_LOG_ERROR_ON=y
CONFIG_MQTT_LOG_WARN_ON=y
CONFIG_MQTT_LOG_INFO_ON=y
CONFIG_MQTT_LOG_DEBUG_ON=y

# TLS/SSL logging
CONFIG_MBEDTLS_SSL_DEBUG_ALL=y
CONFIG_MBEDTLS_SSL_DEBUG_MSG=y
CONFIG_MBEDTLS_SSL_DEBUG_CRT=y
CONFIG_MBEDTLS_SSL_DEBUG_BUF=y
CONFIG_MBEDTLS_SSL_DEBUG_ECP=y
CONFIG_MBEDTLS_SSL_DEBUG_NET=y
CONFIG_MBEDTLS_SSL_DEBUG_MPI=y
CONFIG_MBEDTLS_SSL_DEBUG_PK=y
CONFIG_MBEDTLS_SSL_DEBUG_PKCS12=y

# ===== NETWORK DEBUGGING =====
# Enable network debugging
CONFIG_LWIP_DEBUG=y
CONFIG_LWIP_STATS=y
CONFIG_LWIP_STATS_DISPLAY=y
CONFIG_LWIP_DEBUG_ON=y

# ===== MEMORY DEBUGGING =====
# Enable memory debugging
CONFIG_HEAP_POISONING_COMPREHENSIVE=y
CONFIG_HEAP_TRACING=y
CONFIG_HEAP_TRACING_STACK_DEPTH=10
```
